## OTA/flash_lab/sdkconfig.defaults
```kconfig
CONFIG_IDF_TARGET="esp32"
CONFIG_ESPTOOLPY_FLASHSIZE_4MB=y
CONFIG_ESPTOOLPY_FLASHSIZE="4MB"
CONFIG_PARTITION_TABLE_CUSTOM=y
CONFIG_PARTITION_TABLE_CUSTOM_FILENAME="partitions.csv"
CONFIG_ESP_CONSOLE_UART_DEFAULT=y
CONFIG_ESP_CONSOLE_UART_BAUDRATE=115200
CONFIG_COMPILER_CXX_EXCEPTIONS=n
CONFIG_COMPILER_CXX_RTTI=n
```

## main/Kconfig.projbuild
```kconfig
menu "UWB App Configuration"

choice UWB_NODE_ROLE
    prompt "Default node role"
    default UWB_ROLE_TAG

config UWB_ROLE_TAG
    bool "Tag"

config UWB_ROLE_ANCHOR
    bool "Anchor"
endchoice

config UWB_NODE_ID
    int "Node ID"
    range 1 255
    default 1

config UWB_PEER_ID
    int "Anchor ID addressed by tag"
    range 1 255
    default 100

config UWB_TX_ANTENNA_DELAY
    int "TX antenna delay (device ticks; calibrate per board)"
    range 0 65535
    default 16385

config UWB_RX_ANTENNA_DELAY
    int "RX antenna delay (device ticks; calibrate per board)"
    range 0 65535
    default 16385

endmenu
```
